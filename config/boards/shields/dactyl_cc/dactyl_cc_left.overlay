// dactyl_cc_left.overlay

#include "dactyl_cc.dtsi" // Notice that the main dtsi files are included in the overlay.
// TODO: Put the correct column GPIOs here.
&kscan0 {
    col-gpios
        = <&gpio0 38  GPIO_ACTIVE_HIGH>
        , <&gpio0 36  GPIO_ACTIVE_HIGH>
        , <&gpio0 11  GPIO_ACTIVE_HIGH> 
        , <&gpio0 32  GPIO_ACTIVE_HIGH>
        , <&gpio0 24  GPIO_ACTIVE_HIGH> 
        , <&gpio0 22  GPIO_ACTIVE_HIGH> 
        ;
};
